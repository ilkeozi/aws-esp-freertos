## sdkconfig.defaults
```kconfig
CONFIG_IDF_TARGET=esp32s3
CONFIG_PARTITION_TABLE_CUSTOM=y
CONFIG_PARTITION_TABLE_CUSTOM_FILENAME="partitions.csv"
CONFIG_PARTITION_TABLE_FILENAME="partitions.csv"
CONFIG_PARTITION_TABLE_OFFSET=0xb000ß
CONFIG_APP_WIFI_PROV_TRANSPORT_SOFTAP=y
CONFIG_APP_WIFI_PROV_TRANSPORT_BLE=y
CONFIG_APP_WIFI_PROV_TRANSPORT=2
CONFIG_APP_WIFI_PROV_SHOW_QR=n
CONFIG_GRI_ENABLE_SIMPLE_PUB_SUB=y
CONFIG_GRI_ENABLE_TEMPERATURE_LED_PUB_SUB=y
CONFIG_GRI_ENABLE_OTA=n
CONFIG_BT_ENABLED=y
CONFIG_BT_NIMBLE_ENABLED=y
CONFIG_MBEDTLS_THREADING_C=y
CONFIG_MBEDTLS_THREADING_ALT=n
CONFIG_MBEDTLS_THREADING_PTHREAD=y
CONFIG_ESPTOOLPY_FLASHSIZE_4MB=y
CONFIG_BOOTLOADER_APP_ROLLBACK_ENABLE=y
CONFIG_BOOTLOADER_LOG_LEVEL_ERROR=y
CONFIG_OTA_DATA_OVER_HTTP=n
CONFIG_OTA_DATA_OVER_MQTT=y
CONFIG_OTA_DATA_OVER_MQTT_PRIMARY=y
CONFIG_OTA_PRIMARY_DATA_PROTOCOL=1
CONFIG_ESP_SECURE_CERT_DS_PERIPHERAL=n
CONFIG_ESP_SECURE_CERT_SUPPORT_LEGACY_FORMATS=y
CONFIG_GRI_SUB_PUB_UNSUB_MAX_COMMAND_SEND_BLOCK_TIME_MS=10000
CONFIG_GRI_SUB_PUB_UNSUB_DELAY_BETWEEN_SUB_PUB_UNSUB_LOOPS_MS=10000
CONFIG_GRI_MQTT_AGENT_CONNACK_RECV_TIMEOUT_MS=10000
# Set optimization for size
CONFIG_COMPILER_OPTIMIZATION_SIZE=y

# Set default FreeRTOS Stack sizes
CONFIG_FREERTOS_TIMER_TASK_STACK_DEPTH=1536
CONFIG_FREERTOS_IDLE_TASK_STACKSIZE=1024

# LWIP config
CONFIG_LWIP_MAX_SOCKETS=8

# AWS OTA
CONFIG_LOG2_FILE_BLOCK_SIZE=12
CONFIG_MAX_NUM_BLOCKS_REQUEST=8
CONFIG_MAX_NUM_OTA_DATA_BUFFERS=8
CONFIG_ALLOW_DOWNGRADE=0
CONFIG_OTA_DATA_OVER_MQTT=y
# CONFIG_OTA_DATA_OVER_HTTP is not set
CONFIG_OTA_DATA_OVER_MQTT_PRIMARY=y
CONFIG_OTA_PRIMARY_DATA_PROTOCOL=1

# MbedTLS Config Options
CONFIG_MBEDTLS_TLS_SERVER_AND_CLIENT=n
# CONFIG_MBEDTLS_TLS_SERVER_ONLY is not set
# CONFIG_MBEDTLS_TLS_CLIENT_ONLY is not set
# CONFIG_MBEDTLS_TLS_DISABLED is not set
CONFIG_MBEDTLS_TLS_SERVER=n
CONFIG_MBEDTLS_SERVER_SSL_SESSION_TICKETS=n
CONFIG_MBEDTLS_TLS_CLIENT=y
CONFIG_MBEDTLS_TLS_ENABLED=y
CONFIG_GRI_ENABLE_TEMPERATURE_PUB_SUB_AND_LED_CONTROL=n

# Parkbulurum Configurations
CONFIG_PB_LED=y
CONFIG_PB_LED_RMT=y
CONFIG_PB_CITY="default_city"
CONFIG_PB_AREA="default_area"
CONFIG_PB_ZONE="default_zone"
CONFIG_LED_GPIO=y
CONFIG_LED_GPIO_NUMBER=33
CONFIG_PB_L298N_IN1_GPIO=18
CONFIG_PB_L298N_IN2_GPIO=19
CONFIG_PB_LOCKED_LIMIT_SWITCH_GPIO=12
CONFIG_PB_UNLOCKED_LIMIT_SWITCH_GPIO=14
CONFIG_PB_SERIAL_CONFIG_USB=y
CONFIG_PB_MODEM_DEVICE_SIM7600=y


# PB Uart Configurations
CONFIG_PB_SERIAL_CONFIG_UART=
CONFIG_PB_MODEM_UART_TX_PIN=35
CONFIG_PB_MODEM_UART_RX_PIN=34
CONFIG_PB_MODEM_UART_RTS_PIN=27
CONFIG_PB_MODEM_UART_CTS_PIN=23
CONFIG_PB_MODEM_UART_EVENT_TASK_STACK_SIZE=2048
CONFIG_PB_MODEM_UART_EVENT_TASK_PRIORITY=5
CONFIG_PB_MODEM_UART_EVENT_QUEUE_SIZE=30
CONFIG_PB_MODEM_UART_PATTERN_QUEUE_SIZE=20
CONFIG_PB_MODEM_UART_TX_BUFFER_SIZE=512
CONFIG_PB_MODEM_UART_RX_BUFFER_SIZE=1024
CONFIG_PB_MODEM_PPP_APN="internet"
CONFIG_PB_FLOW_CONTROL=CONFIG_PB_FLOW_CONTROL_NONE
CONFIG_PB_FLOW_CONTROL_NONE=y
CONFIG_PB_FLOW_CONTROL_SW=n
CONFIG_PB_FLOW_CONTROL_HW=n

# MQTT Test 
CONFIG_PB_MQTT_BROKER_URI=""
CONFIG_PB_MQTT_TEST_TOPIC="/topic/esp-pppos"
CONFIG_PB_MQTT_TEST_DATA="esp-pppos"
CONFIG_LWIP_PPP_SUPPORT=y
CONFIG_LWIP_PPP_PAP_SUPPORT=y
```
